## buildroot-external/Config.in
```kconfig
menu "RPI5 Kodi OTA external options"

comment "No extra external packages selected by default"

endmenu
```

## buildroot-external/configs/rpi5_kodi_ota_defconfig
```kconfig
# Raspberry Pi 5 Kodi + OTA template (A/B rootfs) h
BR2_aarch64=y
BR2_cortex_a76=y

BR2_TOOLCHAIN_BUILDROOT_GLIBC=y

BR2_ROOTFS_DEVICE_CREATION_DYNAMIC_MDEV=y
BR2_SYSTEM_DHCP="eth0"
BR2_TARGET_GENERIC_HOSTNAME="rpi5-kodi"
BR2_TARGET_GENERIC_ISSUE="Raspberry Pi 5 Kodi OTA"
BR2_ROOTFS_OVERLAY="$(BR2_EXTERNAL_RPI5_KODI_OTA_PATH)/board/rpi5-kodi-ota/overlay"
BR2_ROOTFS_POST_BUILD_SCRIPT="$(BR2_EXTERNAL_RPI5_KODI_OTA_PATH)/board/rpi5-kodi-ota/post-build.sh"
BR2_ROOTFS_POST_IMAGE_SCRIPT="$(BR2_EXTERNAL_RPI5_KODI_OTA_PATH)/board/rpi5-kodi-ota/post-image.sh"

BR2_LINUX_KERNEL=y
BR2_LINUX_KERNEL_LATEST_VERSION=y
BR2_LINUX_KERNEL_USE_DEFCONFIG=y
BR2_LINUX_KERNEL_DEFCONFIG="bcm2712"
BR2_LINUX_KERNEL_DTS_SUPPORT=y
BR2_LINUX_KERNEL_INTREE_DTS_NAME="broadcom/bcm2712-rpi-5-b"

BR2_PACKAGE_RPI_FIRMWARE=y
BR2_PACKAGE_RPI_FIRMWARE_VARIANT_PI=y
BR2_PACKAGE_RPI_FIRMWARE_CONFIG_FILE="$(BR2_EXTERNAL_RPI5_KODI_OTA_PATH)/board/rpi5-kodi-ota/config.txt"
BR2_PACKAGE_RPI_FIRMWARE_CMDLINE_FILE="$(BR2_EXTERNAL_RPI5_KODI_OTA_PATH)/board/rpi5-kodi-ota/cmdline.txt"

BR2_PACKAGE_KODI=y
BR2_PACKAGE_KODI_PLATFORM_GBM=y
BR2_PACKAGE_KODI_AUDIOENGINE_ALSA=y
BR2_PACKAGE_KODI_RENDER_SYSTEM_GLES=y

BR2_INIT_SYSTEMD=y
BR2_PACKAGE_SYSTEMD_NETWORKD=y
BR2_PACKAGE_SYSTEMD_RESOLVED=y

BR2_PACKAGE_RAUC=y
BR2_PACKAGE_OPENSSL=y
BR2_PACKAGE_CA_CERTIFICATES=y
BR2_PACKAGE_LIBCURL=y
BR2_PACKAGE_LIBCURL_CURL=y
BR2_PACKAGE_E2FSPROGS=y
BR2_PACKAGE_DOSFSTOOLS=y
BR2_PACKAGE_PARTED=y

BR2_PACKAGE_DROPBEAR=y

BR2_TARGET_ROOTFS_EXT2=y
BR2_TARGET_ROOTFS_EXT2_4=y
BR2_TARGET_ROOTFS_EXT2_SIZE="1024M"
BR2_TARGET_ROOTFS_EXT2_LABEL="rootfs"

BR2_TARGET_GENIMAGE=y
BR2_TARGET_GENIMAGE_CFG="$(BR2_EXTERNAL_RPI5_KODI_OTA_PATH)/board/rpi5-kodi-ota/genimage.cfg"
```
